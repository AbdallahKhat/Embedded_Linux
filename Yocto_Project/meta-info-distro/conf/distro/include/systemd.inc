## Yocto_Project/meta-info-distro/conf/distro/include/systemd.inc
```bitbake
# DISTRO_FEATURES:append=" systemd "

# VIRTUAL-RUNTIME_init_manager="systemd"

# VIRTUAL-RUNTIME_initscripts="systemd-compat-units"

INIT_MANAGER = "systemd"
```
